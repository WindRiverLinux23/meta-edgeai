## conf/layer.conf
```bitbake
# We have a conf and classes directory, append to BBPATH
BBPATH .= ":${LAYERDIR}"

# We have a recipes directory, add to BBFILES
BBFILES += "${LAYERDIR}/recipes*/*/*.bb ${LAYERDIR}/recipes*/*/*.bbappend"

BBFILE_COLLECTIONS += "meta-edgeai"
BBFILE_PATTERN_meta-edgeai := "^${LAYERDIR}/"

# We keep the priority higher than all others
BBFILE_PRIORITY_meta-edgeai = "13"

LAYERDEPENDS_meta-edgeai = "core meta-ti-bsp"
LAYERSERIES_COMPAT_meta-edgeai = "kirkstone mickledore"
BBMASK += "${LAYERDIR}/recipes-kernel/linux/"
BBMASK += "${LAYERDIR}/recipes-core"
BBMASK += "${LAYERDIR}/recipes-bsp"
BBMASK += "${LAYERDIR}/wic"
BBMASK += "${LAYERDIR}/recipes-devtools"
BBMASK += "${LAYERDIR}/recipes-demos"
BBMASK += "${LAYERDIR}/recipes-multimedia"
BBMASK += "${LAYERDIR}/recipes-tisdk/edgeai-dependencies"
BBMASK += "${LAYERDIR}/recipes-tisdk/edgeai-components/edgeai-gui-app_0.1.bb"

RECIPE_LIST_REASON:meta-edgeai = "You are about to enable third-party components, there is additional third-part licensing involved, and you might need to consult with your legal department."

require conf/distro/include/edgeai-source-ipk.inc
```
